// Generated by Copilot
#include "serialcmd.h"
#include "storage.h"
#include "leds.h"
#include "sensors.h"

// ═══════════════════════════════════════════════════════════════════════════
// 🔵 INFO: Serial Command Buffer
// ═══════════════════════════════════════════════════════════════════════════

#define CMD_BUFFER_SIZE 64
static char cmdBuffer[CMD_BUFFER_SIZE];
static uint8_t cmdIndex = 0;

// ═══════════════════════════════════════════════════════════════════════════
// 🔵 INFO: Initialize Serial Command Interface
// ═══════════════════════════════════════════════════════════════════════════

void initSerialCmd()
{
  Serial.println(F("\n╔═══════════════════════════════════════════════════════╗"));
  Serial.println(F("║   StairLight Serial Command Interface Active         ║"));
  Serial.println(F("╚═══════════════════════════════════════════════════════╝"));
  Serial.println(F("\nType 'h' for help\n"));
}

// ═══════════════════════════════════════════════════════════════════════════
// 🔵 INFO: Print Help Menu
// ═══════════════════════════════════════════════════════════════════════════

void printHelp()
{
  Serial.println(F("\n╔═══════════════════════════════════════════════════════╗"));
  Serial.println(F("║              COMMAND REFERENCE                        ║"));
  Serial.println(F("╚═══════════════════════════════════════════════════════╝"));
  Serial.println();

  Serial.println(F("📋 DISPLAY COMMANDS:"));
  Serial.println(F("  h              - Show this help"));
  Serial.println(F("  p              - Print current configuration"));
  Serial.println();

  Serial.println(F("🎬 EFFECT TRIGGER COMMANDS:"));
  Serial.println(F("  1              - Start Walk-Up effect"));
  Serial.println(F("  2              - Start Walk-Down effect"));
  Serial.println(F("  3              - Start Knight Rider effect"));
  Serial.println(F("  0              - Stop all effects"));
  Serial.println();

  Serial.println(F("⚙️  CONFIGURATION COMMANDS (format: command=value):"));
  Serial.println(F("  sd=<0-1000>    - Set step delay (ms) for ALL effects"));
  Serial.println(F("  fd=<0-2000>    - Set fade duration (ms) for ALL effects"));
  Serial.println(F("  ov=<0-5>       - Set overlap (LEDs) for ALL effects"));
  Serial.println(F("  br=<0-100>     - Set brightness (%) for ALL effects"));
  Serial.println(F("  to=<0-60000>   - Set effect timeout (ms)"));
  Serial.println();

  Serial.println(F("  sd1=<value>    - Set step delay for Walk-Up only"));
  Serial.println(F("  sd2=<value>    - Set step delay for Walk-Down only"));
  Serial.println(F("  sd3=<value>    - Set step delay for Walk-Up-Out only"));
  Serial.println(F("  sd4=<value>    - Set step delay for Walk-Down-Out only"));
  Serial.println();

  Serial.println(F("  fd1=<value>    - Set fade duration for Walk-Up only"));
  Serial.println(F("  fd2=<value>    - Set fade duration for Walk-Down only"));
  Serial.println(F("  fd3=<value>    - Set fade duration for Walk-Up-Out only"));
  Serial.println(F("  fd4=<value>    - Set fade duration for Walk-Down-Out only"));
  Serial.println();

  Serial.println(F("  ov1=<value>    - Set overlap for Walk-Up only"));
  Serial.println(F("  ov2=<value>    - Set overlap for Walk-Down only"));
  Serial.println(F("  ov3=<value>    - Set overlap for Walk-Up-Out only"));
  Serial.println(F("  ov4=<value>    - Set overlap for Walk-Down-Out only"));
  Serial.println();

  Serial.println(F("  br1=<value>    - Set brightness for Walk-Up only"));
  Serial.println(F("  br2=<value>    - Set brightness for Walk-Down only"));
  Serial.println();

  Serial.println(F("🎯 SENSOR CONFIGURATION:"));
  Serial.println(F("  sens=<0.5-5.0> - Set motion sensitivity (m/s²)"));
  Serial.println(F("  deb=<100-1000> - Set debounce delay (ms)"));
  Serial.println();

  Serial.println(F("💾 STORAGE COMMANDS:"));
  Serial.println(F("  s              - Save current config to EEPROM"));
  Serial.println(F("  l              - Load config from EEPROM"));
  Serial.println(F("  r              - Reset to factory defaults"));
  Serial.println();

  Serial.println(F("Examples:"));
  Serial.println(F("  sd=200         - Set ALL effects step delay to 200ms"));
  Serial.println(F("  br=75          - Set ALL effects brightness to 75%"));
  Serial.println(F("  sd1=150        - Set Walk-Up step delay to 150ms"));
  Serial.println(F("  fd2=600        - Set Walk-Down fade to 600ms"));
  Serial.println(F("  sens=2.0       - Set motion sensitivity to 2.0 m/s²"));
  Serial.println(F("  deb=300        - Set debounce delay to 300ms"));
  Serial.println();
}

// ═══════════════════════════════════════════════════════════════════════════
// 🔵 INFO: Print Current Configuration
// ═══════════════════════════════════════════════════════════════════════════

void printConfig(const SystemConfig &config)
{
  Serial.println(F("\n╔═══════════════════════════════════════════════════════╗"));
  Serial.println(F("║           CURRENT CONFIGURATION                       ║"));
  Serial.println(F("╚═══════════════════════════════════════════════════════╝"));
  Serial.println();

  Serial.println(F("🔼 WALK-UP EFFECT:"));
  Serial.print(F("  Step Delay:     "));
  Serial.print(config.walkUp.stepDelay);
  Serial.println(F(" ms"));
  Serial.print(F("  Fade Duration:  "));
  Serial.print(config.walkUp.fadeDuration);
  Serial.println(F(" ms"));
  Serial.print(F("  Brightness:     "));
  Serial.print(config.walkUp.brightness);
  Serial.println(F(" %"));
  Serial.print(F("  Overlap:        "));
  Serial.print(config.walkUp.overlap);
  Serial.println(F(" LEDs"));
  Serial.print(F("  Enabled:        "));
  Serial.println(config.walkUp.enabled ? F("YES") : F("NO"));
  Serial.println();

  Serial.println(F("🔽 WALK-DOWN EFFECT:"));
  Serial.print(F("  Step Delay:     "));
  Serial.print(config.walkDown.stepDelay);
  Serial.println(F(" ms"));
  Serial.print(F("  Fade Duration:  "));
  Serial.print(config.walkDown.fadeDuration);
  Serial.println(F(" ms"));
  Serial.print(F("  Brightness:     "));
  Serial.print(config.walkDown.brightness);
  Serial.println(F(" %"));
  Serial.print(F("  Overlap:        "));
  Serial.print(config.walkDown.overlap);
  Serial.println(F(" LEDs"));
  Serial.print(F("  Enabled:        "));
  Serial.println(config.walkDown.enabled ? F("YES") : F("NO"));
  Serial.println();

  Serial.println(F("⬆️  WALK-UP-OUT EFFECT:"));
  Serial.print(F("  Step Delay:     "));
  Serial.print(config.walkUpOut.stepDelay);
  Serial.println(F(" ms"));
  Serial.print(F("  Fade Duration:  "));
  Serial.print(config.walkUpOut.fadeDuration);
  Serial.println(F(" ms"));
  Serial.print(F("  Overlap:        "));
  Serial.print(config.walkUpOut.overlap);
  Serial.println(F(" LEDs"));
  Serial.print(F("  Enabled:        "));
  Serial.println(config.walkUpOut.enabled ? F("YES") : F("NO"));
  Serial.println();

  Serial.println(F("⬇️  WALK-DOWN-OUT EFFECT:"));
  Serial.print(F("  Step Delay:     "));
  Serial.print(config.walkDownOut.stepDelay);
  Serial.println(F(" ms"));
  Serial.print(F("  Fade Duration:  "));
  Serial.print(config.walkDownOut.fadeDuration);
  Serial.println(F(" ms"));
  Serial.print(F("  Overlap:        "));
  Serial.print(config.walkDownOut.overlap);
  Serial.println(F(" LEDs"));
  Serial.print(F("  Enabled:        "));
  Serial.println(config.walkDownOut.enabled ? F("YES") : F("NO"));
  Serial.println();

  Serial.println(F("⚙️  GLOBAL SETTINGS:"));
  Serial.print(F("  Effect Timeout: "));
  Serial.print(config.sensor.effectTimeout);
  Serial.println(F(" ms"));
  Serial.print(F("  Global Bright:  "));
  Serial.print(config.globalBrightness);
  Serial.println(F(" %"));
  Serial.println();

  Serial.println(F("🎯 MOTION SENSOR:"));
  Serial.print(F("  Sensitivity:    "));
  Serial.print(config.sensor.accelThreshold, 2);
  Serial.println(F(" m/s²"));
  Serial.print(F("  Debounce:       "));
  Serial.print(config.sensor.debounceDelay);
  Serial.println(F(" ms"));
  Serial.println();
}

// ═══════════════════════════════════════════════════════════════════════════
// 🔵 INFO: Parse and Execute Command
// ═══════════════════════════════════════════════════════════════════════════

void executeCommand(char *cmd, SystemConfig &config)
{
  // 🔵 INFO: Trim whitespace
  while (*cmd == ' ' || *cmd == '\t')
    cmd++;
  if (*cmd == '\0')
    return;

  // ═══════════════════════════════════════════════════════════════════════
  // 🔵 INFO: Single Character Commands
  // ═══════════════════════════════════════════════════════════════════════

  if (cmd[1] == '\0' || cmd[1] == ' ' || cmd[1] == '\t')
  {
    switch (cmd[0])
    {
    case 'h':
    case 'H':
      printHelp();
      return;

    case 'p':
    case 'P':
      printConfig(config);
      return;

    case '1':
      Serial.println(F("▶️  Starting Walk-Up effect..."));
      if (config.walkUp.enabled)
      {
        startEffect(EffectType::WALK_UP, config.walkUp);
      }
      else
      {
        Serial.println(F("⚠️  Walk-Up effect is disabled"));
      }
      return;

    case '2':
      Serial.println(F("▶️  Starting Walk-Down effect..."));
      if (config.walkDown.enabled)
      {
        startEffect(EffectType::WALK_DOWN, config.walkDown);
      }
      else
      {
        Serial.println(F("⚠️  Walk-Down effect is disabled"));
      }
      return;

    case '3':
      Serial.println(F("▶️  Starting Knight Rider effect..."));
      startKnightRider();
      return;

    case '0':
      Serial.println(F("⏹️  Stopping all effects..."));
      stopAllEffects();
      return;
    case 's':
    case 'S':
      Serial.println(F("💾 Saving configuration to EEPROM..."));
      saveConfig(config);
      Serial.println(F("✅ Configuration saved!"));
      return;

    case 'l':
    case 'L':
      Serial.println(F("📂 Loading configuration from EEPROM..."));
      if (loadConfig(config))
      {
        // Apply loaded settings
        setGlobalBrightness(config.globalBrightness);
        setAccelThreshold(config.sensor.accelThreshold);
        setDebounceDelay(config.sensor.debounceDelay);
        setEffectTimeout(config.sensor.effectTimeout);
        Serial.println(F("✅ Configuration loaded!"));
        printConfig(config);
      }
      else
      {
        Serial.println(F("⚠️  Failed to load configuration"));
      }
      return;

    case 'r':
    case 'R':
      Serial.println(F("🔄 Resetting to factory defaults..."));
      resetToDefaults(config);
      saveConfig(config);
      setGlobalBrightness(config.globalBrightness);
      Serial.println(F("✅ Factory reset complete!"));
      printConfig(config);
      return;
    }
  }

  // ═══════════════════════════════════════════════════════════════════════
  // 🔵 INFO: Parameter Setting Commands (format: cmd=value)
  // ═══════════════════════════════════════════════════════════════════════

  char *equals = strchr(cmd, '=');
  if (equals == NULL)
  {
    Serial.println(F("❌ Invalid command format. Use: command=value"));
    Serial.println(F("   Type 'h' for help"));
    return;
  }

  *equals = '\0'; // Split at equals sign
  char *valueStr = equals + 1;
  int value = atoi(valueStr);

  // 🔵 INFO: Apply configuration changes
  bool changed = false;

  // ─────────────────────────────────────────────────────────────────────
  // Step Delay Commands
  // ─────────────────────────────────────────────────────────────────────
  if (strcmp(cmd, "sd") == 0)
  {
    if (value >= 0 && value <= 1000)
    {
      config.walkUp.stepDelay = value;
      config.walkDown.stepDelay = value;
      config.walkUpOut.stepDelay = value;
      config.walkDownOut.stepDelay = value;
      Serial.print(F("✅ ALL step delays set to: "));
      Serial.print(value);
      Serial.println(F(" ms"));
      changed = true;
    }
  }
  else if (strcmp(cmd, "sd1") == 0 && value >= 0 && value <= 1000)
  {
    config.walkUp.stepDelay = value;
    Serial.print(F("✅ Walk-Up step delay: "));
    Serial.print(value);
    Serial.println(F(" ms"));
    changed = true;
  }
  else if (strcmp(cmd, "sd2") == 0 && value >= 0 && value <= 1000)
  {
    config.walkDown.stepDelay = value;
    Serial.print(F("✅ Walk-Down step delay: "));
    Serial.print(value);
    Serial.println(F(" ms"));
    changed = true;
  }
  else if (strcmp(cmd, "sd3") == 0 && value >= 0 && value <= 1000)
  {
    config.walkUpOut.stepDelay = value;
    Serial.print(F("✅ Walk-Up-Out step delay: "));
    Serial.print(value);
    Serial.println(F(" ms"));
    changed = true;
  }
  else if (strcmp(cmd, "sd4") == 0 && value >= 0 && value <= 1000)
  {
    config.walkDownOut.stepDelay = value;
    Serial.print(F("✅ Walk-Down-Out step delay: "));
    Serial.print(value);
    Serial.println(F(" ms"));
    changed = true;
  }

  // ─────────────────────────────────────────────────────────────────────
  // Fade Duration Commands
  // ─────────────────────────────────────────────────────────────────────
  else if (strcmp(cmd, "fd") == 0)
  {
    if (value >= 0 && value <= 2000)
    {
      config.walkUp.fadeDuration = value;
      config.walkDown.fadeDuration = value;
      config.walkUpOut.fadeDuration = value;
      config.walkDownOut.fadeDuration = value;
      Serial.print(F("✅ ALL fade durations set to: "));
      Serial.print(value);
      Serial.println(F(" ms"));
      changed = true;
    }
  }
  else if (strcmp(cmd, "fd1") == 0 && value >= 0 && value <= 2000)
  {
    config.walkUp.fadeDuration = value;
    Serial.print(F("✅ Walk-Up fade duration: "));
    Serial.print(value);
    Serial.println(F(" ms"));
    changed = true;
  }
  else if (strcmp(cmd, "fd2") == 0 && value >= 0 && value <= 2000)
  {
    config.walkDown.fadeDuration = value;
    Serial.print(F("✅ Walk-Down fade duration: "));
    Serial.print(value);
    Serial.println(F(" ms"));
    changed = true;
  }
  else if (strcmp(cmd, "fd3") == 0 && value >= 0 && value <= 2000)
  {
    config.walkUpOut.fadeDuration = value;
    Serial.print(F("✅ Walk-Up-Out fade duration: "));
    Serial.print(value);
    Serial.println(F(" ms"));
    changed = true;
  }
  else if (strcmp(cmd, "fd4") == 0 && value >= 0 && value <= 2000)
  {
    config.walkDownOut.fadeDuration = value;
    Serial.print(F("✅ Walk-Down-Out fade duration: "));
    Serial.print(value);
    Serial.println(F(" ms"));
    changed = true;
  }

  // ─────────────────────────────────────────────────────────────────────
  // Overlap Commands
  // ─────────────────────────────────────────────────────────────────────
  else if (strcmp(cmd, "ov") == 0)
  {
    if (value >= 0 && value <= 5)
    {
      config.walkUp.overlap = value;
      config.walkDown.overlap = value;
      config.walkUpOut.overlap = value;
      config.walkDownOut.overlap = value;
      Serial.print(F("✅ ALL overlaps set to: "));
      Serial.print(value);
      Serial.println(F(" LEDs"));
      changed = true;
    }
  }
  else if (strcmp(cmd, "ov1") == 0 && value >= 0 && value <= 5)
  {
    config.walkUp.overlap = value;
    Serial.print(F("✅ Walk-Up overlap: "));
    Serial.print(value);
    Serial.println(F(" LEDs"));
    changed = true;
  }
  else if (strcmp(cmd, "ov2") == 0 && value >= 0 && value <= 5)
  {
    config.walkDown.overlap = value;
    Serial.print(F("✅ Walk-Down overlap: "));
    Serial.print(value);
    Serial.println(F(" LEDs"));
    changed = true;
  }
  else if (strcmp(cmd, "ov3") == 0 && value >= 0 && value <= 5)
  {
    config.walkUpOut.overlap = value;
    Serial.print(F("✅ Walk-Up-Out overlap: "));
    Serial.print(value);
    Serial.println(F(" LEDs"));
    changed = true;
  }
  else if (strcmp(cmd, "ov4") == 0 && value >= 0 && value <= 5)
  {
    config.walkDownOut.overlap = value;
    Serial.print(F("✅ Walk-Down-Out overlap: "));
    Serial.print(value);
    Serial.println(F(" LEDs"));
    changed = true;
  }

  // ─────────────────────────────────────────────────────────────────────
  // Brightness Commands
  // ─────────────────────────────────────────────────────────────────────
  else if (strcmp(cmd, "br") == 0)
  {
    if (value >= 0 && value <= 100)
    {
      config.walkUp.brightness = value;
      config.walkDown.brightness = value;
      Serial.print(F("✅ Walk-Up/Down brightness set to: "));
      Serial.print(value);
      Serial.println(F(" %"));
      changed = true;
    }
  }
  else if (strcmp(cmd, "br1") == 0 && value >= 0 && value <= 100)
  {
    config.walkUp.brightness = value;
    Serial.print(F("✅ Walk-Up brightness: "));
    Serial.print(value);
    Serial.println(F(" %"));
    changed = true;
  }
  else if (strcmp(cmd, "br2") == 0 && value >= 0 && value <= 100)
  {
    config.walkDown.brightness = value;
    Serial.print(F("✅ Walk-Down brightness: "));
    Serial.print(value);
    Serial.println(F(" %"));
    changed = true;
  }

  // ─────────────────────────────────────────────────────────────────────
  // Timeout Command
  // ─────────────────────────────────────────────────────────────────────
  else if (strcmp(cmd, "to") == 0)
  {
    if (value >= 0 && value <= 60000)
    {
      config.sensor.effectTimeout = value;
      setEffectTimeout(value);
      Serial.print(F("✅ Effect timeout set to: "));
      Serial.print(value);
      Serial.println(F(" ms"));
      changed = true;
    }
  }

  // ─────────────────────────────────────────────────────────────────────
  // Sensor Configuration Commands
  // ─────────────────────────────────────────────────────────────────────
  else if (strcmp(cmd, "sens") == 0)
  {
    // Parse float value for sensitivity
    float floatValue = atof(valueStr);
    if (floatValue >= 0.5 && floatValue <= 5.0)
    {
      config.sensor.accelThreshold = floatValue;
      setAccelThreshold(floatValue);
      Serial.print(F("✅ Motion sensitivity set to: "));
      Serial.print(floatValue, 2);
      Serial.println(F(" m/s²"));
      changed = true;
    }
    else
    {
      Serial.println(F("❌ Sensitivity must be between 0.5 and 5.0"));
    }
  }
  else if (strcmp(cmd, "deb") == 0)
  {
    if (value >= 100 && value <= 1000)
    {
      config.sensor.debounceDelay = value;
      setDebounceDelay(value);
      Serial.print(F("✅ Debounce delay set to: "));
      Serial.print(value);
      Serial.println(F(" ms"));
      changed = true;
    }
    else
    {
      Serial.println(F("❌ Debounce must be between 100 and 1000 ms"));
    }
  }

  if (!changed)
  {
    Serial.println(F("❌ Invalid command or value out of range"));
    Serial.println(F("   Type 'h' for help"));
  }
}

// ═══════════════════════════════════════════════════════════════════════════
// 🔵 INFO: Update Serial Command Handler
// ⚪ NOTE: Call this in main loop to process keyboard input
// ═══════════════════════════════════════════════════════════════════════════

void updateSerialCmd(SystemConfig &config)
{
  while (Serial.available() > 0)
  {
    char c = Serial.read();

    // 🔵 INFO: Handle newline/carriage return as command terminator
    if (c == '\n' || c == '\r')
    {
      if (cmdIndex > 0)
      {
        cmdBuffer[cmdIndex] = '\0'; // Null terminate
        Serial.println();           // Echo newline
        executeCommand(cmdBuffer, config);
        cmdIndex = 0;          // Reset buffer
        Serial.print(F("> ")); // Show prompt
      }
    }
    // 🔵 INFO: Handle backspace
    else if (c == '\b' || c == 127)
    {
      if (cmdIndex > 0)
      {
        cmdIndex--;
        Serial.write('\b'); // Move cursor back
        Serial.write(' ');  // Overwrite character
        Serial.write('\b'); // Move cursor back again
      }
    }
    // 🔵 INFO: Add character to buffer
    else if (cmdIndex < CMD_BUFFER_SIZE - 1)
    {
      cmdBuffer[cmdIndex++] = c;
      Serial.write(c); // Echo character
    }
  }
}
